## config/boards/shields/knob_w/Kconfig.defconfig
```kconfig
if SHIELD_KNOB_W
config BT_LONG_WQ_STACK_SIZE
    default 4096
config BT_CTLR_RX_PRIO_STACK_SIZE
    default 2048
config BT_CTLR_RX_STACK_SIZE
    default 3072
config ZMK_KEYBOARD_NAME
    default "KNOB-W"
endif
```

## config/dts/bindings/behaviors/braxon,knob-control.yaml
```yaml
description: KNOB-W fixed navigation and configurable encoder actions
compatible: "braxon,knob-control"
include: one_param.yaml
```

## config/dts/bindings/behaviors/braxon,knob-scroll.yaml
```yaml
description: Single relative wheel step for a KNOB-W encoder detent
compatible: "braxon,knob-scroll"
include: one_param.yaml
```
